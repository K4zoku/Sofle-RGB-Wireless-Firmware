## config/Kconfig
```kconfig
menuconfig ZMK_VIA
    bool "VIA compatibility for ZMK"
    depends on RAW_HID
    depends on ZMK_KEYMAP_SETTINGS_STORAGE
    depends on DT_HAS_ZMK_VIA_MATRIX_ENABLED
    default n
    help
      Expose the current ZMK runtime keymap through the QMK/VIA Raw HID
      protocol. A board/keymap must provide a zmk,via-matrix node with
      rows, columns, and a map array of ZMK position indices.

config ZMK_VIA_CUSTOM_KEYCODES
    bool "Enable keyboard-specific VIA custom keycodes"
    depends on ZMK_VIA
    default n

config ZMK_VIA_MACRO_COUNT
    int "Number of VIA macros"
    depends on ZMK_VIA
    range 1 32
    default 16
    help
      Number of macro slots exposed to stock VIA.

config ZMK_VIA_MACRO_BUFFER_SIZE
    int "VIA macro buffer size"
    depends on ZMK_VIA
    range 1 65535
    default 1024
    help
      Total number of bytes reserved for VIA's NUL-delimited macro buffer.

config ZMK_VIA_MACRO_DELAY_MS
    int "VIA macro key delay"
    depends on ZMK_VIA
    range 0 1000
    default 5
    help
      Delay between queued macro key press and release events.

config ZMK_VIA_ENCODER
    bool "Expose and persist encoder bindings to VIA"
    depends on ZMK_VIA
    default n


config ZMK_VIA_CUSTOM_KEYCODE_PROFILE
    int "VIA custom keycode profile"
    depends on ZMK_VIA_CUSTOM_KEYCODES
    range 0 1
    default 0
```

## config/dts/bindings/zmk,via-compat.yaml
```yaml
description: VIA compatibility behavior for QMK layer, mouse, and modifier keycodes
compatible: "zmk,via-compat"
include: two_param.yaml
```

## config/dts/bindings/zmk,via-encoder.yaml
```yaml
description: VIA encoder proxy behavior storing raw QMK keycodes
compatible: "zmk,via-encoder"

properties:
  label:
    type: string
    required: false
    deprecated: true
  "#binding-cells":
    type: int
    required: true
    const: 1
  "#sensor-binding-cells":
    type: int
    required: true
    const: 2

sensor-binding-cells:
  - param1
  - param2
```

## config/dts/bindings/zmk,via-macro.yaml
```yaml
description: Runtime macro behavior backed by the VIA macro buffer
compatible: "zmk,via-macro"
include: one_param.yaml
```

## config/dts/bindings/zmk,via-matrix.yaml
```yaml
description: Virtual matrix adapter for generic VIA keymap access
compatible: "zmk,via-matrix"
properties:
  rows:
    type: int
    required: true
  columns:
    type: int
    required: true
  map:
    type: array
    required: true
```

## config/west.yml
```yaml
manifest:
  remotes:
    - name: zmkfirmware
      url-base: https://github.com/zmkfirmware
    - name: zzeneg
      url-base: https://github.com/zzeneg
  projects:
    - name: zmk
      remote: zmkfirmware
      revision: edf5c0814fd3ea202e43aad2d68fd32e882a518c
      import: app/west.yml
    - name: zmk-raw-hid
      remote: zzeneg
      revision: 6a37765dfab6197292e7a9f47305dcf87386d56a
  self:
    path: config
```
